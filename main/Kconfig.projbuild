## main/Kconfig.projbuild
```kconfig
menu "ESP32 DevKit Flasher"

    config BTN_GPIO
        int "Boot button GPIO number"
        range 0 35
        default 0

    config LED_GPIO
        int "Blue LED GPIO number"
        range 0 35
        default 2

    menu "Serial to flash"

        choice FLASH_UART
            prompt "UART peripheral number"
            default SERIAL_UART_1

            config SERIAL_UART_1
                bool "UART 1 (default)"
            config SERIAL_UART_2
                bool "UART 2"
        endchoice

        config FLASH_RXD
            int "RXD GPIO"
            range 1 35
            default 5

        config FLASH_TXD
            int "TXD GPIO"
            range 1 35
            default 4

        config FLASH_RESET
            int "Reset GPIO"
            range 1 35
            default 25

        config FLASH_IO0
            int "IO0 GPIO"
            range 1 35
            default 26

    endmenu

endmenu
```

## sdkconfig.defaults
```kconfig
# https://github.com/espressif/esp-at/blob/master/module_config/module_esp32_default/sdkconfig.defaults

#
# Serial flasher config
#
CONFIG_ESPTOOLPY_FLASHMODE_DIO=y
CONFIG_ESPTOOLPY_FLASHFREQ_40M=y
CONFIG_ESPTOOLPY_FLASHSIZE_4MB=y

#
# Partition config
#
CONFIG_PARTITION_TABLE_CUSTOM=y

#
# ESP32-specific
#
CONFIG_ESP32_DEFAULT_CPU_FREQ_80=y
CONFIG_ESP32_DEFAULT_CPU_FREQ_MHZ=80
CONFIG_ESP32_XTAL_FREQ_40=y
CONFIG_ESP32_XTAL_FREQ=40
```
